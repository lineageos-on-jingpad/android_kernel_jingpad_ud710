## drivers/gpu/sprd/Kconfig
```kconfig
menuconfig SPRD_GPU_SUPPORT
    tristate "SPRD GPU Driver Support"
    default n
    help
      Enable support for the SPRD GPU driver. This driver provides support
      for GPUs in Spreadtrum platforms. It is required for 2D/3D rendering
      and acceleration on compatible devices.

if SPRD_GPU_SUPPORT

config SPRD_GPU_POWERVR
    tristate "PowerVR GPU Driver Support"
    default n
    help
      Enable support for PowerVR GPUs on SPRD platforms.

      This option enables drivers for Mali architectures.

endif # SPRD_GPU_SUPPORT
```

## drivers/input/fingerprint/goodix/Kconfig
```kconfig
#
# Goodix Fingerprint driver configuration
#

config GOODIX_FP
	tristate "Goodix Fingerprint driver support"
	help
	  This supports Goodix Fingerprint drivers.
```

## drivers/input/fingerprint/silead/Kconfig
```kconfig
#
# Silead Fingerprint driver configuration
#

config SILEAD_FP
	tristate "Silead Fingerprint driver support"
	help
	  This supports Silead Fingerprint drivers.
```

## drivers/input/touchscreen/elan_ts/Kconfig
```kconfig
config TOUCHSCREEN_ELAN_EKTS
	tristate "Elan eKTH I2C touchscreen"
	depends on I2C
	help
	  Say Y here if you have an Elan eKTH I2C touchscreen
	  connected to your system.

	  If unsure, say N.

	  To compile this driver as a module, choose M here: the
	  module will be called elants_i2c.
```

## drivers/input/touchscreen/goodix_ts/Kconfig
```kconfig
#
# Goodix touchscreen driver configuration
#
config TOUCHSCREEN_GOODIX_GT738X
	tristate "Goodix GT738x touchscreen"
	depends on I2C
	default y
	help
	  Say Y here if you have a Goodix GT738x touch controller
	  to your system.

	  If unsure, say N.
```

## drivers/soc/sprd/bsp/Kconfig
```kconfig
config BSP_BOARD_CAMERA_MODULE_VDSP_DEVICE
    string "Support SPRD Board VDSP Device"
    default ""
```

## drivers/soc/sprd/camera/Kconfig
```kconfig
menuconfig SPRD_CAMERA_SUPPORT
	tristate "Support SPRD Camera Driver"

if SPRD_CAMERA_SUPPORT

config SPRD_CAMERA_CORE
	tristate "Support SPRD Camera Core Driver"
    depends on SPRD_CAMERA_FLASH_DRV && SPRD_CAMERA_SENSOR

config SPRD_CAMERA_CPP
	tristate "Support SPRD Camera CPP Driver"

config SPRD_CAMERA_FD
	tristate "Support SPRD Camera FD Driver"
    depends on SPRD_CAMERA_CORE

config SPRD_CAMERA_FLASH
	tristate "Support SPRD Camera Flash Sensor Driver"

config SPRD_CAMERA_FLASH_DRV
	tristate "Support SPRD Camera Flash DRV Driver"
    depends on SPRD_CAMERA_FLASH

config SPRD_CAMERA_FLASH_SENSOR_IC
	tristate "Support SPRD Camera Flash Sensor IC Driver"
    depends on SPRD_CAMERA_FLASH_DRV

config SPRD_CAMERA_FLASH_SENSOR_IC_NAME
	string "SPRD Camera Flash Sensor IC Name"
	default ""
	depends on SPRD_CAMERA_FLASH_SENSOR_IC

config SPRD_CAMERA_MMDVFS
	tristate "Support SPRD Camera MMDVFS Driver"

config SPRD_CAMERA_SENSOR
	tristate "Support SPRD Camera Sensor Driver"

config SPRD_CAMERA_VDSP
	tristate "Support SPRD Camera VDSP Driver"
	depends on !SPRD_NPU_VDSP

endif # SPRD_CAMERA_SUPPORT
```

## drivers/soc/sprd/npu/Kconfig
```kconfig
menuconfig SPRD_NPU_SUPPORT
    tristate "SPRD NPU Support"
    default n

if SPRD_NPU_SUPPORT

config SPRD_NPU_IMG
    tristate "IMG NPU Driver Support"
    default n

config SPRD_NPU_VDSP
    tristate "VDSP NPU Driver Support"
    default n

endif # SPRD_NPU_SUPPORT
```

## drivers/soc/sprd/wcn/Kconfig
```kconfig
menuconfig SPRD_WCN_SUPPORT
    tristate "SPRD WCN Support"
    default n

if SPRD_WCN_SUPPORT

config SPRD_WCN_BLUETOOTH
    tristate "SPRD WCN Bluetooth Driver Support"
    default n

config SPRD_WCN_FM
    tristate "SPRD WCN FM Driver Support"
    default n

config SPRD_WCN_WLAN
    tristate "SPRD WCN WLAN Driver Support"
    default n

endif # SPRD_WCN_SUPPORT
```
